## boards/arm/stm32f103_fc/Kconfig.board
```kconfig
# STM32F103ZET6 fc board configuration

# Copyright (c) 2020 WuhanStudio
# SPDX-License-Identifier: Apache-2.0

config BOARD_STM32F103_FC
	bool "STM32F103ZET6 flight controller Board"
	depends on SOC_STM32F103XE
```

## boards/arm/stm32f103_fc/Kconfig.defconfig
```kconfig
# STM32F103ZET6 fc board configuration

# Copyright (c) 2020 WuhanStudio
# SPDX-License-Identifier: Apache-2.0

if BOARD_STM32F103_FC

config BOARD
	default "stm32f103_fc"

endif # BOARD_STM32F103_fc
```
